## components/chest_controller/Kconfig
```kconfig
menu "Chest controller"

config CHEST_ENABLE_SERVO
    bool "Enable SG90 lid actuator"
    default n
    help
        Initialize and drive the SG90 lid actuator after a verified KWS and
        voiceprint event. The C5 servo branch enables this in sdkconfig.defaults
        after the PWM wiring and external 5 V supply are connected.

config CHEST_ENABLE_DISPLAY
    bool "Enable GC9A01 status display"
    default n
    help
        Initialize the GC9A01 display and show the voice-listening state plus
        the lid command state. The display branch enables this in
        sdkconfig.defaults after the SPI wiring is connected.

endmenu
```

## components/kws_wakeup/Kconfig
```kconfig
menu "KWS wakeup configuration"

    config KWS_WIFI_SSID
        string "Wi-Fi SSID"
        default ""

    config KWS_WIFI_PASSWORD
        string "Wi-Fi password"
        default ""

    config KWS_SERVER_URI
        string "KWS WebSocket URI"
        default "ws://114.132.243.95/v1/kws/listen"

    config KWS_DEVICE_ID
        string "KWS device ID"
        default "ESP32-CHEST-001"

    config KWS_PRODUCT_ID
        string "KWS product ID"
        default "eagle"

    config KWS_AUTH_TOKEN
        string "KWS auth token"
        default ""
        help
            Leave empty when KWS_AUTH_ENABLED is false on the backend.

    config KWS_RECONNECT_DELAY_MS
        int "Reconnect delay (ms)"
        range 500 60000
        default 2000

endmenu
```

## components/voiceprint_auth/Kconfig
```kconfig
menu "Voiceprint authentication configuration"

    config VOICEPRINT_SERVER_URL
        string "Voiceprint HTTP server URL"
        default "http://114.132.243.95:80"

    config VOICEPRINT_SPEAKER_ID
        string "Owner voiceprint speaker ID"
        default "esp32-chest-owner-001"

    config VOICEPRINT_DISPLAY_NAME
        string "Owner voiceprint display name"
        default "ESP32 Chest Owner"

    config VOICEPRINT_HTTP_TIMEOUT_MS
        int "Voiceprint HTTP timeout (ms)"
        range 3000 60000
        default 15000

endmenu
```
